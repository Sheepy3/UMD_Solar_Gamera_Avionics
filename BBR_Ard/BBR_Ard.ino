
const int BaudRate = 9600;
const unsigned long updateRate = 1000; // milliseconds 
const int debug = 1; // 1 = debug on
//-------------------------------------------------------------------
// Hall Effect Sensor (A3114)
const byte hallPin = 2;  // A3114 Pin. Ensure A3114 is within 7mm from magnet on motor shaft. And 10 kOhm pull-up resistor (neg and pos)

volatile unsigned int pulseCount = 0;
float rpm = 0;
unsigned long lastMillis = 0;
const float pulsesPerRevolution = 1.0; // number of magnets on shaft
const float rpmConversionFactor = 60000.0/(updateRate*pulsesPerRevolution); 

// Helper function - Interrupt Service Routine (ISR) 
void countPulse() {
  pulseCount++; // add one everytime function is called 
}

// LOW = Magnet Detected
// HIGH = Magnet not 

//-------------------------------------------------------------------
// Current Sensor (ACS712)
const int currentPin = A0;  // ACS712  Analogue Pin. Ensure ACS712 is in series with motor. 

// Conversion values -- fine tune these experimentally 
const float mVperAmp = 69.9; 
/* 30 A module = 66 mV per amp
  This is the voltage generated by hall effect sensor proportional to incoming current. 
  NOT voltage going through motor
*/ 

const float ACSoffset = 2494.5; // Baseline voltage at 0A (in mV)

const int currentSamples = 100; // how many samples to average 

float RawValue = 0;
float Voltage = 0;
float Amps = 0;

//-------------------------------------------------------------------
// LED - will light up if RPM > 0
const int ledPin = 13;   // Basic LED

//-------------------------------------------------------------------

void setup() {
  Serial.begin(BaudRate);
  Serial.println("Starting...");
  // RPM Setup
  pinMode(hallPin, INPUT);  // using external 10kohm resistor 
  attachInterrupt(digitalPinToInterrupt(hallPin), countPulse, FALLING);
  /*  Initializes hardware to interrupt; Arduino will monitor hallPin 
  during loop, everytime signal changes from HIGH to LOW (FALLING), call countPulse
  */

  pinMode(ledPin, OUTPUT);
  if (debug==HIGH){
     Serial.println("DEBUG MODE ON");
    } else {
      Serial.println("DEBUG MODE OFF");
    }
}

//-------------------------------------------------------------------

void loop() {
  if (millis() - lastMillis >= updateRate) {
     if (debug==HIGH){
      Serial.println("New Line");
     }
//-------------------------------------------------------------------
    // RPM Loop
    noInterrupts(); 
    /* temporally disable interrupts to read pulses gathered in last second, 
    and resets pulseCount for next loop
    */
    unsigned int currentPulses = pulseCount; // store pulses counted in last second (from attachInterupt in setup)
    pulseCount = 0; // reset pulse-counter
    interrupts(); // go back to counting

    rpm = currentPulses * rpmConversionFactor;     // Calculate RPM from pulses counted


//-------------------------------------------------------------------
    // Current Loop
    long rawSum = 0;

    // Accumulate samples -- note if currentSamples = 100, takes 10-12 ms to gather. make sure its not too significant of updateRate
    for (int i = 0; i<currentSamples; i++){
      rawSum += analogRead(currentPin);
    }

    RawValue = rawSum / (float)currentSamples; // calculate average
    Voltage = (RawValue / 1024.0) * 5000.0; // convert to mV
    Amps = (ACSoffset - Voltage) / mVperAmp; // convert to Amps

//-------------------------------------------------------------------
   // Turn on LED when RPM > 0 detected
   if (rpm > 0) { 
    digitalWrite(ledPin, HIGH);
   } else {
    digitalWrite(ledPin, LOW);
   }
//-------------------------------------------------------------------

    // Print to serial
    Serial.print("RPM: ");
    Serial.print(rpm, 2);

    if (debug==HIGH){
    Serial.print("\tCurrent Sensor Raw Value: ");
    Serial.print(RawValue, 2);

    Serial.print("\tVoltage (mV): ");
    Serial.print(Voltage, 1);
    }

    Serial.print("\tCurrent (A): ");
    Serial.println(Amps, 3);
    lastMillis += updateRate; // reset for next loop
  }
}
